## app/boards/native_posix_64.conf
```kconfig
CONFIG_GPIO=n
# Enable to have the native posix build expose USBIP device(s)
# CONFIG_ZMK_USB=y
CONFIG_LOG=y
CONFIG_LOG_BACKEND_SHOW_COLOR=n
CONFIG_ZMK_LOG_LEVEL_DBG=y
CONFIG_SERIAL=y
CONFIG_DEBUG=y
CONFIG_SYS_CLOCK_TICKS_PER_SEC=1000

CONFIG_UART_NATIVE_POSIX=y
CONFIG_NATIVE_UART_0_ON_STDINOUT=y
```

## app/dts/bindings/zmk,kscan-ptty.yaml
```yaml
description: |
  Allows defining a mock keyboard scan driver that accepts a list of commands from the POSIX terminal.

compatible: "zmk,kscan-ptty"

properties:
  label:
    type: string
  event-period:
    type: int
    description: Milliseconds between each generated event
  rows:
    type: int
  columns:
    type: int
  exit-after:
    type: boolean
```
