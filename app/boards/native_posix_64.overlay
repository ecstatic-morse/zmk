#include <behaviors.dtsi>
#include <dt-bindings/zmk/keys.h>
#include <dt-bindings/zmk/kscan_mock.h>

/ {
    chosen {
        zmk,kscan = &kscan;
    };

    kscan: kscan {
        compatible = "zmk,kscan-ptty";
        label = "KSCAN_MOCK";

        rows = <2>;
        columns = <2>;
        exit-after;
        event-period = <10>;
    };
};

&uart0 {
    status = "okay";
};